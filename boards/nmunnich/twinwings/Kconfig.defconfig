## boards/nmunnich/twinwings/Kconfig.defconfig
```kconfig
# Copyright (c) 2026 Nicolas Munnich
# SPDX-License-Identifier: MIT

if BOARD_TWINWINGS_LEFT

config BOARD
    default "TwinWings Left"

config ZMK_SPLIT_ROLE_CENTRAL
    default y

endif

if BOARD_TWINWINGS_RIGHT

config BOARD
    default "TwinWings Right"

endif

if BOARD_TWINWINGS_LEFT || BOARD_TWINWINGS_RIGHT

config ZMK_SPLIT
    default y

config BT_CTLR
    default BT

config PINCTRL
    default y

if USB

config USB_NRFX
    default y

config USB_DEVICE_STACK
    default y

endif

endif
```

## boards/nmunnich/twinwings/board.yml
```yaml
boards:
  - name: twinwings_left
    vendor: nmunnich
    socs:
      - name: nrf52840
  - name: twinwings_right
    vendor: nmunnich
    socs:
      - name: nrf52840
```

## boards/nmunnich/twinwings/twinwings_left_defconfig
```kconfig
# Copyright (c) 2026 Nicolas Munnich
# SPDX-License-Identifier: MIT

# Enable both USB and BLE
CONFIG_ZMK_USB=y
CONFIG_ZMK_BLE=y

# Keyboard IDs
CONFIG_ZMK_KEYBOARD_NAME="TwinWings Left"

# Enable MPU
CONFIG_ARM_MPU=y

# Enable GPIO
CONFIG_GPIO=y

# Build configurations
CONFIG_BUILD_OUTPUT_UF2=y
CONFIG_USE_DT_CODE_PARTITION=y

# Flash configuration
CONFIG_MPU_ALLOW_FLASH_WRITE=y
CONFIG_NVS=y
CONFIG_SETTINGS_NVS=y
CONFIG_FLASH=y
CONFIG_FLASH_PAGE_LAYOUT=y
CONFIG_FLASH_MAP=y
```
